## boards/shields/mykeeb/Kconfig.defconfig
```kconfig
if SHIELD_MYKEEB

config ZMK_KEYBOARD_NAME
    default "baubas keeb"

config EC11
    default y

config ZMK_KSCAN_DEBOUNCE_PRESS_MS
    default 5

config ZMK_KSCAN_DEBOUNCE_RELEASE_MS
    default 5

config SPI
    default y

config ZMK_STUDIO
    default y

endif
```
